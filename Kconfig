## Kconfig
```kconfig
menu "Captive Wi-Fi"

    config CAPTIVE_WIFI_AP_SSID_PREFIX
        string "SoftAP name prefix (short device name)"
        default "ESP"
        help
            Short device name used for the setup SoftAP: "<prefix>-xxxxxx", where xxxxxx are
            the last 3 bytes of the device's base MAC address in lower case (e.g. "mppt-1a2b3c",
            "solar-810840") — the same as on its label / serial number. A lower-case prefix lets
            the application use the same text as its host name.
            At most 24 characters; a longer prefix is cut.

    config CAPTIVE_WIFI_AP_PASSWORD
        string "SoftAP password (empty = open network)"
        default ""

    config CAPTIVE_WIFI_MAX_RETRIES
        int "Failed connection attempts before the portal starts"
        range 1 100
        default 10
        help
            Only when the stored network has not answered once since boot (e.g. a wrong or
            changed network): after this many failed attempts the setup portal opens. The
            stored network keeps being tried in the background while the portal is open.

    config CAPTIVE_WIFI_RETRY_BURST
        int "Connection attempts in a row before a pause"
        range 1 50
        default 5
        help
            The stored network is never given up: after this many failed attempts in a row
            the component waits CAPTIVE_WIFI_RETRY_PAUSE_S and starts the next burst.

    config CAPTIVE_WIFI_RETRY_PAUSE_S
        int "Pause between bursts of attempts (s)"
        range 10 120
        default 60
        help
            Pause between bursts of connection attempts to the stored network. While the setup
            portal is open, the stored network is also tried once per pause in the background,
            and the portal closes as soon as it connects. A restarting router needs about 2 min.

    config CAPTIVE_WIFI_AP_ONLY
        bool "Access point only mode (for an application with its own web interface)"
        default n
        help
            captive_wifi_start_ap(): the SoftAP without the portal, the station and the DNS
            catch-all, so the application serves its own web interface at 192.168.4.1 (e.g. for
            installations without a router). Off: the component is the Wi-Fi connection with the
            setup portal only, as before 0.4.0; captive_wifi_start_ap() returns
            ESP_ERR_NOT_SUPPORTED and its code is not built in.

    config CAPTIVE_WIFI_PORTAL_IDLE_MIN
        int "Close the portal after this many minutes without a client (0 = never)"
        range 0 1440
        default 0
        help
            Only when no network is stored: if no phone joins the setup portal for this long
            (counted from the start and from the last client leaving), the portal closes and the
            radio is switched off (CAPTIVE_WIFI_EVT_PORTAL_TIMEOUT) until captive_wifi_start() is
            called again (a restart, or the application). Saves power on a device that is not
            meant to be on Wi-Fi. With a stored network the portal stays and keeps trying it.
            0 keeps the portal open forever (as before 0.4.0).

endmenu
```
